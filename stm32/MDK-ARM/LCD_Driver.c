#include "LCD_Driver.h"
uint8_t g_line=0;
uint8_t g_x=0;
void LCD_WriteByte(uint8_t dc,uint8_t b)
{
	uint8_t i;
	SCE_H;
	SCE_L;
	if(dc) DC_H;
	else DC_L;
	for(i=0;i<8;i++)
	{
		//10101010
		SCLK_L;
		if(b&0x80)
		DIN_H;
		else DIN_L;
		SCLK_H;
		b=b<<1;
		//delay_us(50);
	}
	SCLK_L;
	DIN_L;
	SCE_H;
	//delay_us(100);
}

void LCD_Init(void)
{
	SCE_H;
	RST_L;
	HAL_Delay(10);
	RST_H;
	LCD_WriteByte(CMD,0x21);
  LCD_WriteByte(CMD,0xc8);
  LCD_WriteByte(CMD,0x06);
  LCD_WriteByte(CMD,0x13);
  LCD_WriteByte(CMD,0x20);
  LCD_Clean();
  LCD_WriteByte(CMD,0x0c);
	SCE_L;
}

void LCD_SetXY(uint8_t x,uint8_t y)
{
	g_x=x;g_line=y;
	x=83-x;
	y=5-y;
	x+=0x80;
	y+=0x40;
	
	LCD_WriteByte(CMD,x);
	LCD_WriteByte(CMD,y);
}

void LCD_Clean(void)
{
	uint16_t i=503;
	for(i=0;i<503;i++)
	{
		LCD_WriteByte(DAT,0x00);
	}
}

uint8_t GetFont(uint8_t dat)
{
	return dat-32;
}

uint8_t bin[]={1,2,4,8,16,32,64,128};
unsigned char Reverse(unsigned char x)
{
	unsigned char t=0;
	for(unsigned char i=0;i<8;i++)
	{
		t+=((x&0x80)?1:0)*bin[i];
		x<<=1;
	}
	return t;
}

void g_puts(uint8_t ch)
{
	uint8_t i,p=GetFont(ch);
	for(i=0;i<6;i++)
	{
		LCD_SetXY(g_x,g_line);
		LCD_WriteByte(DAT,Reverse(font6x8[p][i]));
		//LCD_WriteByte(DAT,font6x8[p][i]);
		g_x++;
		
	}
}

//write by userdefine-font
void u_puts(uint8_t* user_define_font)
{
	uint8_t i;
	for(i=0;i<6;i++)
	{
		LCD_SetXY(g_x,g_line);
		LCD_WriteByte(DAT,Reverse(user_define_font[i]));
		//LCD_WriteByte(DAT,font6x8[p][i]);
		g_x++;
	}
}

void g_print(char* dat)
{
	uint8_t cc=*dat;//ShowChar(cc);
	while(cc!=0)
	{
		cc=*(dat++);
		g_puts(cc);
	}
}

void SetLine(uint8_t line)
{
	g_line=line;
	//LCD_SetXY(83,5-line);
	LCD_SetXY(0,line);
}

uint8_t line_ctl=0;

void GUI_SetLine(uint8_t line)
{
	line_ctl=line;
}

void f_print(char* dat)
{
	uint8_t cnt=0,length=strlen((const char*)dat);
	char buffer[14];
	memset(buffer,0,sizeof(buffer));
	if(length<=14)
	{
		memset(buffer,' ',sizeof(buffer));
		for(cnt=0;cnt<length;cnt++)
			buffer[cnt]=dat[cnt];
		l_print(buffer,line_ctl,Left);
		if(line_ctl==6)
			line_ctl=0;
		else
			line_ctl++;
	}
	else
	{
		while(length-cnt>14)
		{
			memcpy(buffer,dat+cnt,14);
			l_print((char*)&"              ",line_ctl,Left);
			l_print(buffer,line_ctl,Left);
			if(line_ctl==6)
				line_ctl=0;
			else
				line_ctl++;
			memset(buffer,0,sizeof(buffer));
			cnt+=14;
		}
		memcpy(buffer,dat+cnt,length-cnt);
		uint8_t t_buffer[14];
		memset(t_buffer,' ',sizeof(t_buffer));
		for(cnt=0;cnt<length;cnt++)
			t_buffer[cnt]=buffer[cnt];
		l_print(buffer,line_ctl,Left);
		if(line_ctl==6)
				line_ctl=0;
		else
			line_ctl++;
	}
}

void l_print(char* dat,uint8_t line,enum StrLocation loc)
{
	//14 chars
	uint8_t length=strlen((const char*)dat),i;
	if(loc==Middle)
	{
		SetLine(line);
		for(i=0;i<(14-length)/2;i++) g_puts(' ');
	}		
	else if(loc==Left) SetLine(line);
	else if(loc==Right) LCD_SetXY(13-length,line);
	g_print(dat);
}

unsigned char font6x8[][6] =  
{  
    { 0x00, 0x00, 0x00, 0x00, 0x00, 0x00 },   // sp  
    { 0x00, 0x00, 0x00, 0x2f, 0x00, 0x00 },   // !  
    { 0x00, 0x00, 0x07, 0x00, 0x07, 0x00 },   // "  
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    { 0x14, 0x14, 0x14, 0x14, 0x14, 0x14 }    // horiz lines  
};
